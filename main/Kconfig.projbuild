## main/Kconfig.projbuild
```kconfig
menu "LCD Configuration"
    config WAVESHARE_1_28INCH_TOUCH_LCD
        bool "1.28inch Touch LCD"
        default y
        help
            The product is not yet available for sale
    
    config Round_LCD_screen
        bool "This LCD is circular"
        default y
        depends on WAVESHARE_1_28INCH_TOUCH_LCD
        help
            This LCD is circular

    choice DISPLAY_ROTATION_ANGLE
        prompt "Display Angle"
        default EXAMPLE_DISPLAY_ROTATION_90_DEGREE
        help
            Set the screen rotation Angle(On by default).
    
    config EXAMPLE_DISPLAY_ROTATION_0_DEGREE    
        bool "Set the screen to rotate 0 degrees"
        help
            Set the screen to rotate 0 degrees
    config EXAMPLE_DISPLAY_ROTATION_90_DEGREE    
        bool "Set the screen to rotate 90 degrees"
        help
            Set the screen to rotate 90 degrees 
    config EXAMPLE_DISPLAY_ROTATION_180_DEGREE  
        bool "Set the screen to rotate 180 degrees"
        help
            Set the screen to rotate 180 degrees 
    config EXAMPLE_DISPLAY_ROTATION_270_DEGREE  
        bool "Set the screen to rotate 270 degrees"
        help
            Set the screen to rotate 270 degrees
    endchoice

    # choice LVGL_CONFIGURATION
    #     prompt "LVGL configuration"
    #     depends on WAVESHARE_1_28INCH_TOUCH_LCD
    #     default LV_COLOR_16_SWAP
    #     help
    #         Swap the 2 bytes of RGB565 color. Useful if the display has an 8-bit interface.
    #         - 2.8inch Touch LCD (Disable)
    
    # config LV_COLOR_16_SWAP
    #     bool "Swap the 2 bytes of RGB565 color"
    #     help
    #         Swap the 2 bytes of RGB565 color
    # endchoice
    


    config BT_ENABLED
        bool "Select this option to enable Bluetooth"
        default y 

    config BT_BLE_50_FEATURES_SUPPORTED
        bool "Enabling this option activates BLE 5.0 features"
        default y 
        
    config BT_BLE_42_FEATURES_SUPPORTED
        bool "This enables BLE 4.2 features."
        default y 
    
endmenu

menu "Realistic Eyes"
    config EYES_REALISTIC
        bool "Use the realistic eye renderer (bypasses LVGL)"
        default y
        help
            Renders textured eyes with saccades, blinking and pupil changes directly
            to both panels. If disabled, the original LVGL canvas animation runs.

    choice EYES_IRIS_COLOR
        prompt "Iris colour"
        default EYES_IRIS_HAZEL
        depends on EYES_REALISTIC

    config EYES_IRIS_HAZEL
        bool "Hazel / green"
    config EYES_IRIS_BLUE
        bool "Blue"
    config EYES_IRIS_BROWN
        bool "Brown"
    endchoice

    menu "Gaze Link (ESP-NOW face tracking)"
        depends on EYES_REALISTIC

        config GAZE_LINK_ENABLED
            bool "Receive look-at targets from the face-tracking camera"
            default y
            help
                Listens for ESP-NOW packets from the camera module (see sender/). While a
                face is reported, most saccades go to it; otherwise the eyes look around freely.

        config GAZE_LINK_CHANNEL
            int "Wi-Fi channel"
            range 1 13
            default 1
            depends on GAZE_LINK_ENABLED
            help
                Must match the channel configured in the sender.

        config GAZE_LINK_GAIN_X
            int "Horizontal gain (%)"
            range 10 300
            default 100
            depends on GAZE_LINK_ENABLED
            help
                100 maps the full camera image width to the full horizontal eye range.

        config GAZE_LINK_GAIN_Y
            int "Vertical gain (%)"
            range 10 300
            default 100
            depends on GAZE_LINK_ENABLED

        config GAZE_LINK_INVERT_X
            bool "Invert horizontal direction"
            default y
            depends on GAZE_LINK_ENABLED
            help
                The camera looks out from the face, so a person on the camera image's left
                stands on the viewer's right. Toggle if the eyes look away from you.

        config GAZE_LINK_INVERT_Y
            bool "Invert vertical direction"
            default n
            depends on GAZE_LINK_ENABLED
    endmenu
endmenu
```

## sender/main/Kconfig.projbuild
```kconfig
menu "Face Sender"
    config SENDER_CHANNEL
        int "Wi-Fi channel"
        range 1 13
        default 1
        help
            Must match "Gaze Link" channel on the eye board.

    config SENDER_TEST_PATTERN
        bool "Test pattern instead of camera"
        default n
        help
            Sends a slowly wandering target (and a 4 s gap every 20 s) without using
            the camera, to test the eye board on its own.

    config SENDER_HMIRROR
        bool "Mirror camera image horizontally"
        default n
        depends on !SENDER_TEST_PATTERN

    config SENDER_VFLIP
        bool "Flip camera image vertically"
        default n
        depends on !SENDER_TEST_PATTERN
endmenu
```
